## config/west.yml
```yaml
manifest:
  remotes:
    - name: zmkfirmware
      # url-base: https://github.com/zmkfirmware
      url-base: https://github.com/ekiwookie/
  projects:
    - name: zmk
      remote: zmkfirmware
      revision: main
      # revision: mouse-ftc
      import: app/west.yml
  self:
    path: config
```
